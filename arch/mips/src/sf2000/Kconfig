## arch/mips/src/sf2000/Kconfig
```kconfig
#
# For a description of the syntax of this configuration file,
# see the file kconfig-language.txt in the NuttX tools repository.
#

if ARCH_CHIP_SF2000
comment "SF2000 Configuration Options"

choice
	prompt "SF2000 chip selection"
	default ARCH_CHIP_SF2000

config ARCH_CHIP_SF2000
	bool "SF2000"
	select ARCH_CHIP_SF2000
	---help---
		DataFrog SF2000 (MPS32)
		ARCH_CHIP_SF2000

endchoice

config ARCH_CHIP_SF2000
	bool
	default y
	select ARCH_MIPS32

menu "SF2000 Peripheral Support"

config SF2000_WDT
	bool "Watchdog timer (WDT)"
	default n

config SF2000_T2
	bool "Timer 2 (T2)"
	default n

config SF2000_T3
	bool "Timer 3 (T3)"
	default n

config SF2000_T4
	bool "Timer 4 (T4)"
	default n

config SF2000_T5
	bool "Timer 5 (T5)"
	default n

config SF2000_IC1
	bool "Input Capture 1 (IC1)"
	default n

config SF2000_IC2
	bool "Input Capture 2 (IC2)"
	default n

config SF2000_IC3
	bool "Input Capture 3 (IC3)"
	default n

config SF2000_IC4
	bool "Input Capture 4 (IC4)"
	default n

config SF2000_IC5
	bool "Input Capture 5 (IC5)"
	default n

config SF2000_OC1
	bool "Output Compare 1 (OC1)"
	default n

config SF2000_OC2
	bool "Output Compare 2 (OC2)"
	default n

config SF2000_OC3
	bool "Output Compare 3 (OC3)"
	default n

config SF2000_OC4
	bool "Output Compare 4 (OC4)"
	default n

config SF2000_OC5
	bool "Output Compare 5 (OC5)"
	default n

config SF2000_I2C1
	bool "I2C1"
	default n

config SF2000_I2C2
	bool "I2C2"
	default n

config SF2000_I2C3
	bool "I2C3"
	default n

config SF2000_I2C4
	bool "I2C4"
	default n

config SF2000_I2C5
	bool "I2C5"
	default n

config SF2000_SPI1
	bool "SPI1"
	default n
	select SF2000_SPI

config SF2000_SPI2
	bool "SPI2"
	default n
	select SF2000_SPI

config SF2000_SPI3
	bool "SPI3"
	default n
	select SF2000_SPI

config SF2000_SPI4
	bool "SPI4"
	default n
	select SF2000_SPI

config SF2000_UART1
	bool "UART1"
	default n
	select UART1_SERIALDRIVER
	select ARCH_HAVE_SERIAL_TERMIOS

config SF2000_UART2
	bool "UART2"
	default n
	select UART2_SERIALDRIVER
	select ARCH_HAVE_SERIAL_TERMIOS

config SF2000_UART3
	bool "UART3"
	default n
	select UART3_SERIALDRIVER
	select ARCH_HAVE_SERIAL_TERMIOS

config SF2000_UART4
	bool "UART4"
	default n
	select UART4_SERIALDRIVER
	select ARCH_HAVE_SERIAL_TERMIOS

config SF2000_UART5
	bool "UART5"
	default n
	select UART5_SERIALDRIVER
	select ARCH_HAVE_SERIAL_TERMIOS

config SF2000_UART6
	bool "UART6"
	default n
	select UART6_SERIALDRIVER
	select ARCH_HAVE_SERIAL_TERMIOS

config SF2000_ADC
	bool "ADC1"
	default n

config SF2000_PMP
	bool "Parallel Master Port (PMP)"
	default n

config SF2000_CM1
	bool "Comparator 1 (CM1)"
	default n

config SF2000_CM2
	bool "Comparator 2 (CM2)"
	default n

config SF2000_CM3
	bool "Comparator 3 (CM3)"
	default n

config SF2000_RTCC
	bool "Real-Time Clock and Calendar (RTCC)"
	default n

config SF2000_DMA
	bool "DMA"
	default n
	select ARCH_DMA

config SF2000_FLASH
	bool "FLASH"
	default n

config SF2000_USBDEV
	bool "USB device"
	default n

config SF2000_USBHOST
	bool "USB host"
	default n

config SF2000_CAN1
	bool "Controller area network 1 (CAN1)"
	default n

config SF2000_CAN2
	bool "Controller area network 2 (CAN2)"
	default n

config SF2000_ETHERNET
	bool "Ethernet"
	default n
	select NETDEVICES
	select ARCH_HAVE_PHY
	select ARCH_HAVE_NETDEV_STATISTICS

config SF2000_CTMU
	bool "Charge Time Measurement Unit (CMTU)"
	default n

endmenu

menu "SF2000 Peripheral Interrupt Priorities"

config SF2000_CTPRIO
	int "Core Timer Interrupt (CT)"
	default 16
	---help---
		Core Timer Interrupt.  Range 4-31, Default 16.

config SF2000_CS0PRIO
	int "Core Software Interrupt 0 (CS0)"
	default 16
	---help---
		Core Software Interrupt 0.  Range 4-31, Default 16.

config SF2000_CS1PRIO
	int "Core Software Interrupt 1 (CS1)"
	default 16
	---help---
		Core Software Interrupt 1.  Range 4-31, Default 16.

config SF2000_INT0PRIO
	int "External Interrupt 0 (INT0)"
	default 16
	---help---
		External Interrupt 0.  Range 4-31, Default 16.

config SF2000_INT1PRIO
	int "External Interrupt 1 (INT1)"
	default 16
	---help---
		External Interrupt 1.  Range 4-31, Default 16.

config SF2000_INT2PRIO
	int "External Interrupt 2 (INT2)"
	default 16
	---help---
		External Interrupt 2.  Range 4-31, Default 16.

config SF2000_INT3PRIO
	int "External Interrupt 3 (INT3)"
	default 16
	---help---
		External Interrupt 3.  Range 4-31, Default 16.

config SF2000_INT4PRIO
	int "External Interrupt 4 (INT4)"
	default 16
	---help---
		External Interrupt 4.  Range 4-31, Default 16.

config SF2000_FSCMPRIO
	int "Fail-Safe Clock Monitor (FSCM)"
	default 16
	depends on SF2000_
	---help---
		Fail-Safe Clock Monitor.  Range 4-31, Default 16.

config SF2000_T1PRIO
	int "Timer 1 (T1)"
	default 16
	---help---
		Timer 1 (System timer) priority.  Range 4-31, Default 16.

config SF2000_T2PRIO
	int "Timer 2 (T2)"
	default 16
	depends on SF2000_T2
	---help---
		Timer 2 priority.  Range 4-31, Default 16.

config SF2000_T3PRIO
	int "Timer 3 (T3)"
	default 16
	depends on SF2000_T3
	---help---
		Timer 3 priority.  Range 4-31, Default 16.

config SF2000_T4PRIO
	int "Timer 4 (T4)"
	default 16
	depends on SF2000_T4
	---help---
		Timer 4 priority.  Range 4-31, Default 16.

config SF2000_T5PRIO
	int "Timer 5 (T5)"
	default 16
	depends on SF2000_
	---help---
		Timer 5 priority.  Range 4-31, Default 16.

config SF2000_IC1PRIO
	int "Input Capture 1 (IC1)"
	default 16
	depends on SF2000_IC1
	---help---
		Input Capture 1.  Range 4-31, Default 16.

config SF2000_IC2PRIO
	int "Input Capture 2 (IC2)"
	default 16
	depends on SF2000_IC2
	---help---
		Input Capture 2.  Range 4-31, Default 16.

config SF2000_IC3PRIO
	int "Input Capture 3 (IC3)"
	default 16
	depends on SF2000_IC3
	---help---
		Input Capture 3.  Range 4-31, Default 16.

config SF2000_IC4PRIO
	int "Input Capture 4 (IC4)"
	default 16
	depends on SF2000_IC4
	---help---
		Input Capture 4.  Range 4-31, Default 16.

config SF2000_IC5PRIO
	int "Input Capture 5 (IC5)"
	default 16
	depends on SF2000_IC5
	---help---
		Input Capture 5.  Range 4-31, Default 16.

config SF2000_OC1PRIO
	int "Output Compare 1 (OC1)"
	default 16
	depends on SF2000_OC1
	---help---
		Output Compare 1.  Range 4-31, Default 16.

config SF2000_OC2PRIO
	int "Output Compare 2 (OC2)"
	default 16
	depends on SF2000_OC2
	---help---
		Output Compare 2.  Range 4-31, Default 16.

config SF2000_OC3PRIO
	int "Output Compare 3 (OC3)"
	default 16
	depends on SF2000_OC3
	---help---
		Output Compare 3.  Range 4-31, Default 16.

config SF2000_OC4PRIO
	int "Output Compare 4 (OC4)"
	default 16
	depends on SF2000_OC4
	---help---
		Output Compare 4.  Range 4-31, Default 16.

config SF2000_OC5PRIO
	int "Output Compare 5 (OC5)"
	default 16
	depends on SF2000_OC5
	---help---
		Output Compare 5.  Range 4-31, Default 16.

config SF2000_I2C1PRIO
	int "I2C1"
	default 16
	depends on SF2000_I2C1
	---help---
		I2C 1.  Range 4-31, Default 16.

config SF2000_I2C2PRIO
	int "I2C2"
	default 16
	depends on SF2000_I2C3
	---help---
		I2C 2.  Range 4-31, Default 16.

config SF2000_I2C3PRIO
	int "I2C3"
	default 16
	depends on SF2000_I2C3
	---help---
		I2C 3.  Range 4-31, Default 16.

config SF2000_I2C4PRIO
	int "I2C4"
	default 16
	depends on SF2000_I2C4
	---help---
		I2C 4.  Range 4-31, Default 16.

config SF2000_I2C5PRIO
	int "I2C5"
	default 16
	depends on SF2000_I2C5
	---help---
		I2C 5.  Range 4-31, Default 16.

config SF2000_SPI1PRIO
	int "SPI1"
	default 16
	depends on SF2000_SPI1
	---help---
		SPI 2

config SF2000_SPI2PRIO
	int "SPI2"
	default 16
	depends on SF2000_SPI2
	---help---
		SPI 2

config SF2000_UART1PRIO
	int "UART1"
	default 16
	depends on SF2000_UART1
	---help---
		UART 1.  Range 4-31, Default 16.

config SF2000_UART2PRIO
	int "UART2"
	default 16
	depends on SF2000_UART2
	---help---
		UART 2.  Range 4-31, Default 16.

config SF2000_CNPRIO
	int "CN"
	default 16
	depends on SF2000_CN
	---help---
		Input Change Interrupt.  Range 4-31, Default 16.

config SF2000_ADCPRIO
	int "ADC1"
	default 16
	depends on SF2000_ADC1
	---help---
		ADC1 Convert Done.  Range 4-31, Default 16.

config SF2000_PMPPRIO
	int "Parallel Master Port (PMP)"
	default 16
	depends on SF2000_PMP
	---help---
		Parallel Master Port.  Range 4-31, Default 16.

config SF2000_CM1PRIO
	int "Comparator 1 (CM1)"
	default 16
	depends on SF2000_CM1
	---help---
		Comparator 1.  Range 4-31, Default 16.

config SF2000_CM2PRIO
	int "Comparator 2 (CM2)"
	default 16
	depends on SF2000_CM2
	---help---
		Comparator 2.  Range 4-31, Default 16.

config SF2000_RTCCPRIO
	int "Real-Time Clock and Calendar (RTCC)"
	default 16
	depends on SF2000_RTCC
	---help---
		Real-Time Clock and Calendar.  Range 4-31, Default 16.

config SF2000_DMA0PRIO
	int "DMA0"
	default 16
	depends on SF2000_DMA
	---help---
		DMA Channel 0.  Range 4-31, Default 16.

config SF2000_DMA1PRIO
	int "DMA1"
	default 16
	depends on SF2000_DMA
	---help---
		DMA Channel 1.  Range 4-31, Default 16.

config SF2000_DMA2PRIO
	int "DMA2"
	default 16
	depends on SF2000_DMA
	---help---
		DMA Channel 2.  Range 4-31, Default 16.

config SF2000_DMA3PRIO
	int "DMA3"
	default 16
	depends on SF2000_DMA
	---help---
		DMA Channel 3.  Range 4-31, Default 16.

config SF2000_DMA4PRIO
	int "DMA4"
	default 16
	depends on SF2000_DMA
	---help---
		DMA Channel 4.  Range 4-31, Default 16.

config SF2000_DMA5PRIO
	int "DMA5"
	default 16
	depends on SF2000_DMA
	---help---
		DMA Channel 5.  Range 4-31, Default 16.

config SF2000_DMA6PRIO
	int "DMA6"
	default 16
	depends on SF2000_DMA
	---help---
		DMA Channel 6.  Range 4-31, Default 16.

config SF2000_DMA7PRIO
	int "DMA7"
	default 16
	depends on SF2000_DMA
	---help---
		DMA Channel 7.  Range 4-31, Default 16.

config SF2000_FCEPRIO
	int "FCE"
	default 16
	depends on SF2000_FLASH
	---help---
		Flash Control Event.  Range 4-31, Default 16.

config SF2000_USBPRIO
	int "USB"
	default 16
	depends on SF2000_USBDEV || SF2000_USBHOST
	---help---
		USB.  Range 4-31, Default 16.

endmenu

config SF2000_GPIOIRQ
	bool "GPIO Interrupt"
	default n
	depends on EXPERIMENTAL
	---help---
		Build in support for interrupts based on GPIO inputs from IOPorts

config SF2000_JTAG_ENABLE
	bool "Enable JTAG"
	default n
	depends on ARCH_CHIP_SF20003 || ARCH_CHIP_SF20004 || ARCH_CHIP_SF20005 || ARCH_CHIP_SF20006 || ARCH_CHIP_SF20007
	---help---
		Enable JTAG on power-up.  This is a run-time setting needed for the 3xx/4xx/5xx/6xx/7xx series.
		SF2000 devices are hardwired to enable JTAG by default at boot time.  NuttX disables JTAG by
		default in order to prevent unintentional data leakage over JTAG.


menu "SPI Driver Configuration"
	depends on SF2000_SPI

config SF2000_SPI_INTERRUPTS
	bool "SPI Interrupt Driven"
	default n
	depends on EXPERIMENTAL

config SF2000_SPI_ENHBUF
	bool "SPI Enhanced Buffer Mode"
	default n
	depends on EXPERIMENTAL

config SF2000_SPI_REGDEBUG
	bool "SPI Register level debug"
	depends on DEBUG_INFO
	default n
	---help---
		Output detailed register-level SPI device debug information.
		Requires also CONFIG_DEBUG_FEATURES.

endmenu # SPI Driver Configuration

menu "SF2000 PHY/Ethernet device driver settings"
	depends on SF2000_ETHERNET

config SF2000_PHY_AUTONEG
	bool "Auto-negotiation"
	default y
	depends on SF2000_ETHERNET
	---help---
		Enable auto-negotiation

config SF2000_PHY_SPEED100
	bool "100Mbps spped"
	default n
	depends on SF2000_ETHERNET && !SF2000_PHY_AUTONEG
	---help---
		Select 100Mbit vs. 10Mbit speed.

config SF2000_PHY_FDUPLEX
	bool "Full duplex"
	default n
	depends on SF2000_ETHERNET && !SF2000_PHY_AUTONEG
	---help---
		Select full (vs. half) duplex

config SF2000_ETH_NTXDESC
	int "Number Tx descriptors"
	default 2
	depends on SF2000_ETHERNET
	---help---
		Configured number of Tx descriptors. Default: 2

config SF2000_ETH_NRXDESC
	int "Number Rx descriptors"
	default 4
	depends on SF2000_ETHERNET
	---help---
		Configured number of Rx descriptors. Default: 4

config SF2000_ETH_PRIORITY
	int ""
	default 28
	depends on SF2000_ETHERNET
	---help---
		Ethernet interrupt priority.  The is default is the highest priority.

config SF2000_MULTICAST
	bool "Multicast"
	default NET_MCASTGROUP
	depends on SF2000_ETHERNET
	---help---
		Enable receipt of multicast (and unicast) frames. Automatically set if
		NET_MCASTGROUP is selected.

config NET_REGDEBUG
	bool "Register level debug"
	default n
	depends on SF2000_ETHERNET && DEBUG_NET_INFO
	---help---
		Enabled low level register debug.  Also needs CONFIG_DEBUG_FEATURES.

endmenu

menu "Device Configuration 0 (DEVCFG0)"

config SF2000_DEBUGGER
	int "Debugger"
	default 3
	---help---
		Background Debugger Enable. Default 3 (disabled). The value 2 enables.

config SF2000_ICESEL
	int "ICE channel"
	default 1
	---help---
		In-Circuit Emulator/Debugger Communication Channel Select. Default 1 (PG2)

config SF2000_PROGFLASHWP
	hex "Program FLASH write protect"
	default 0x3ff if ARCH_CHIP_SF20001 || ARCH_CHIP_SF20002
	default 0xff if !ARCH_CHIP_SF20001 && !ARCH_CHIP_SF20002
	---help---
		Program FLASH write protect.  Default 0xff (disabled)

config SF2000_BOOTFLASHWP
	int "Boot FLASH write protect"
	default 1
	---help---
		Default 1 (disabled)

config SF2000_CODEWP
	int "Code write protect"
	default 1
	---help---
		Default 1 (disabled)

endmenu

menu "Device Configuration 1 (DEVCFG1)"

config SF2000_OSCOUT
	int "USB ID"
	default 0
	depends on ARCH_CHIP_SF20001 || ARCH_CHIP_SF20002
	---help---
		USB USBID Selection.  Default 1 if USB enabled (USBID pin is controlled by the USB
		module), but 0 (GPIO) otherwise.

endmenu

menu "Device Configuration 3 (DEVCFG3)"

config SF2000_USBIDO
	int "USB ID"
	default 1 if SF2000_USB
	default 0 if !SF2000_USB
	---help---
		USB USBID Selection.  Default 1 if USB enabled (USBID pin is controlled by the USB
		module), but 0 (GPIO) otherwise.

config SF2000_VBUSIO
	int "USB VBUSON"
	default 1 if SF2000_USB
	default 0 if !SF2000_USB
	---help---
		USB VBUSON Selection (Default 1 if USB enabled (VBUSON pin is controlled by the USB
		module, but 0 (GPIO) otherwise.

config SF2000_WDENABLE
	bool "Watchdog enable"
	default 0
	---help---
		Enabled watchdog on power up.  Default 0 (watchdog can be enabled later by software).

config SF2000_FETHIO
	int "Ethernet I/O pins"
	default 1
	---help---
		Ethernet I/O Pin Selection bit:

		1 = Default Ethernet I/O Pins
		0 = Alternate Ethernet I/O Pins

config SF2000_FMIIEN
	int "Ethernet MII"
	default 1
	---help---
		Ethernet MII Enable bit

		1 = MII enabled
		0 = RMII enabled

endmenu

endif
```
